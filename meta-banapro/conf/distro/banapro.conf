## meta-banapro/conf/distro/banapro.conf
```bitbake
DISTRO = "banapro"
DISTRO_NAME = "BananaPro Embedded Linux"
DISTRO_VERSION = "1.0"

require conf/distro/poky.conf

DISTRO_FEATURES:append = " wifi bluetooth systemd wayland"
VIRTUAL-RUNTIME_init_manager = "systemd"
VIRTUAL-RUNTIME_initscripts = "systemd-compat-units"

# Pull in useful debug utilities by default
IMAGE_FEATURES:append = " ssh-server-openssh package-management"

# Weston/Wayland stack needs GBM support from mesa (not mesa-gl)
PREFERRED_PROVIDER_virtual/libgl = "mesa"
```

## meta-banapro/conf/layer.conf
```bitbake
# Layer configuration for meta-banapro

BBPATH .= ":${LAYERDIR}"
BBFILES += "${LAYERDIR}/recipes-*/*/*.bb \
            ${LAYERDIR}/recipes-*/*/*.bbappend"

BBFILE_COLLECTIONS += "banapro"
BBFILE_PATTERN_banapro = "^${LAYERDIR}/"
BBFILE_PRIORITY_banapro = "6"

# Compatible with recent LTS Yocto releases
LAYERSERIES_COMPAT_banapro = "kirkstone mickledore nanbield scarthgap"
```

## meta-banapro/conf/machine/bananapro.conf
```bitbake
# Yocto machine configuration for Banana Pro (Allwinner A20)

require conf/machine/include/sun7i.inc

MACHINEOVERRIDES =. "bananapro:bananapi:a20:"

# Force open-source Mesa stack for Wayland/GBM
PREFERRED_PROVIDER_virtual/libgl = "mesa"
PREFERRED_PROVIDER_virtual/mesa = "mesa"
PREFERRED_PROVIDER_virtual/libgles1 = "mesa"
PREFERRED_PROVIDER_virtual/libgles2 = "mesa"
PREFERRED_PROVIDER_virtual/egl = "mesa"

SERIAL_CONSOLE = "115200 ttyS0"

PREFERRED_PROVIDER_virtual/kernel ?= "linux-mainline"
PREFERRED_PROVIDER_virtual/bootloader ?= "u-boot"

KERNEL_DEVICETREE = "allwinner/sun7i-a20-bananapro.dtb"

IMAGE_BOOT_FILES:append = " bpi-m1p-lcd.dtbo;overlays/bpi-m1p-lcd.dtbo"
KERNEL_DTC_FLAGS:append = " -@"

UBOOT_CONFIG ??= "bananapro"
UBOOT_CONFIG[bananapro] = "Bananapro_defconfig"

MACHINE_FEATURES += "wifi bluetooth screen"

# Drop Mali binary blobs added by the common sunxi include
XSERVER:remove = "sunxi-mali sunxi-mali-dev"
MACHINE_ESSENTIAL_EXTRA_RRECOMMENDS:remove = "kernel-module-mali kernel-module-mali-drm"
```
